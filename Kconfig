## Kconfig
```kconfig
# Copyright (c) 2026
# SPDX-License-Identifier: MIT

config ZMK_BEHAVIOR_ORBIT
    bool
    default y
    depends on DT_HAS_ZMK_BEHAVIOR_ORBIT_ENABLED
```

## dts/bindings/behaviors/zmk,behavior-alt-tab.yaml
```yaml
description: Alt Tab encoder behavior

compatible: "zmk,behavior-alt-tab"

properties:
  label:
    type: string

  "#sensor-binding-cells":
    type: int
    required: true
    const: 0

  timeout-ms:
    type: int
    default: 1000
```

## dts/bindings/behaviors/zmk,behavior-orbit.yaml
```yaml
description: Configurable dual-mode rotary encoder behavior

compatible: "zmk,behavior-orbit"

properties:
  label:
    type: string

  "#sensor-binding-cells":
    type: int
    required: true
    const: 0

  clockwise:
    type: array
    required: true
    description: >
      Two keycodes. First for clockwise rotation,
      second for counter-clockwise rotation when
      clockwise mode is active.

  counter-clockwise:
    type: array
    required: true
    description: >
      Two keycodes. First for clockwise rotation,
      second for counter-clockwise rotation when
      counter-clockwise mode is active.

  clockwise-keep-mods:
    type: array
    description: Optional modifiers held during clockwise mode.

  counter-clockwise-keep-mods:
    type: array
    description: Optional modifiers held during counter-clockwise mode.

  timeout-ms:
    type: int
    default: 1000
```
